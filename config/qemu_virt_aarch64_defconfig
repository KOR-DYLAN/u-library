## config/qemu_virt_aarch64_defconfig
```kconfig
# For Build
CONFIG_BOOT_BL2=y
CONFIG_PLATFORM_QEMU_VIRT=y
CONFIG_PLATFORM=qemu-virt
CONFIG_LIBRARY_AARCH64=y
CONFIG_DRIVER_UART=y
CONFIG_DRIVER_UART_PL011=y

# For Build Options
CONFIG_CROSS_COMPILE=aarch64-none-linux-gnu-
CONFIG_SYSTEM_ARCH=armv8-a
CONFIG_SYSTEM_CORE=cortex-a53
CONFIG_NO_JUMP_TABLES=y
CONFIG_NO_BUILTIN=y
CONFIG_NOSTDINC=n
CONFIG_NOSTDLIB=y
CONFIG_GENERAL_REGS_ONLY=y
CONFIG_STRICT_ALIGN=y
CONFIG_ENV_BAREMETAL=y

# For QEMU
CONFIG_QEMU_CPU=cortex-a53
CONFIG_QEMU_SMP=4
CONFIG_QEMU_RAM=1G
CONFIG_QEMU_GIC=2
CONFIG_QEMU_SECURE=on
CONFIG_QEMU_VIRTUALIZATION=off
CONFIG_QEMU_MACHINE=virt,gic-version=$(CONFIG_QEMU_GIC)
CONFIG_QEMU_FLAGS=-d unimp -semihosting-config enable=on -nographic
CONFIG_QEMU=qemu-system-aarch64
```
